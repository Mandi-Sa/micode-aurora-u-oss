## drivers/mi_ufs/eua/Kconfig
```kconfig
# SPDX-License-Identifier: GPL-2.0-only
#
# Mi ufs eua
#
#
config UFS_EUA
	bool "UFS EUA"
	depends on SCSI_UFS_QCOM
	help
	 Kernel configuration file for UFS EUA feature

config UFS_EUA_CHECK
	bool "UFS EUA CHECK"
	depends on UFS_EUA
	default n
	help
	 Kernel configuration file for UFS EUA feature check
```

## drivers/mi_ufs/swap/Kconfig
```kconfig
# SPDX-License-Identifier: GPL-2.0-only
#
# Mi ufs swap
#
#
config UFS_SWAP
        bool "UFS SWAP"
        depends on SCSI_UFS_QCOM
        help
         Kernel configuration file for UFS SWAP feature
```
